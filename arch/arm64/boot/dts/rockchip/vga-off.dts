/dts-v1/;
/plugin/;

/ {
	fragment@0 {
		target = <&cdn_dp>;

		__overlay__ {
			status = "disabled";
		};
	};

	fragment@1 {
		target = <&dp_in_vopl>;

		__overlay__ {
			status = "disabled";
		};
	};
};
